## ArduinoCam/OnboardVision/main/Kconfig.projbuild
```kconfig
menu "RobotSys onboard vision"
    config ROBOT_VISION_CONFIDENCE_PERCENT
        int "Minimum detection confidence (percent)"
        range 25 95
        default 50
    config ROBOT_VISION_INTERVAL_MS
        int "Pause between completed inferences (milliseconds)"
        range 100 10000
        default 200
    config ROBOT_CAMERA_VFLIP
        bool "Vertically flip sensor image (saved S3-EYE sketch setting)"
        default y
    config ROBOT_CAMERA_HMIRROR
        bool "Horizontally mirror sensor image"
        default n
    config ROBOT_VISION_SERIAL_SNAPSHOT
        bool "Export one processed JPEG over USB serial for diagnosis"
        default n
        help
            Emit one vision_snapshot JSON event after ten successful inferences
            to allow camera exposure and white balance to settle. It contains
            the actual processed camera JPEG as base64,
            with the same boot ID, sequence, and capture timestamp as its
            vision_frame. This pauses capture while the image is transmitted.
            Keep serial logs private; they will contain a camera image.
endmenu

menu "RobotSys WiFi and Laravel"
    config ROBOT_WIFI_SSID
        string "WiFi SSID"
        default ""
    config ROBOT_WIFI_PASSWORD
        string "WiFi Password"
        default ""
    config ROBOT_LARAVEL_URL
        string "Laravel API URL for vision frames"
        default "http://192.168.23.12:8000/api/vision/frames"
    config ROBOT_VISION_TOKEN
        string "Laravel Sanctum token for vision:ingest"
        default ""
    config ROBOT_VISION_DEVICE_ID
        string "Onboard vision device ID"
        default "CAM-S3-001"
endmenu
```

## ArduinoCam/OnboardVision/sdkconfig.defaults
```kconfig
CONFIG_IDF_TARGET="esp32s3"
CONFIG_ESPTOOLPY_FLASHMODE_QIO=y
CONFIG_ESPTOOLPY_FLASHFREQ_80M=y
CONFIG_ESPTOOLPY_FLASHSIZE_16MB=y
CONFIG_PARTITION_TABLE_CUSTOM=y
CONFIG_PARTITION_TABLE_CUSTOM_FILENAME="partitions.csv"
CONFIG_COMPILER_OPTIMIZATION_PERF=y
CONFIG_SPIRAM=y
CONFIG_SPIRAM_MODE_OCT=y
CONFIG_SPIRAM_SPEED_80M=y
CONFIG_SPIRAM_USE_MALLOC=y
CONFIG_ESP_DEFAULT_CPU_FREQ_MHZ_240=y
CONFIG_ESP32S3_INSTRUCTION_CACHE_32KB=y
CONFIG_ESP32S3_DATA_CACHE_64KB=y
CONFIG_ESP32S3_DATA_CACHE_LINE_64B=y
CONFIG_ESP_SYSTEM_ALLOW_RTC_FAST_MEM_AS_HEAP=n
CONFIG_ESP_TASK_WDT_TIMEOUT_S=40
CONFIG_ESP_CONSOLE_UART_DEFAULT=y
CONFIG_ESP_CONSOLE_UART_BAUDRATE=115200
# CONFIG_FLASH_COCO_DETECT_YOLO11N_S8_V1 is not set
CONFIG_FLASH_COCO_DETECT_YOLO11N_320_S8_V1=y
CONFIG_COCO_DETECT_YOLO11N_320_S8_V1=y
CONFIG_COCO_DETECT_MODEL_IN_FLASH_RODATA=y


# WiFi and Laravel integration
CONFIG_ROBOT_WIFI_SSID=CISA_TO
CONFIG_ROBOT_WIFI_PASSWORD=
CONFIG_ROBOT_LARAVEL_URL=http://192.168.23.12:8000/api/vision/frames
CONFIG_ROBOT_VISION_TOKEN=
CONFIG_ROBOT_VISION_DEVICE_ID=CAM-S3-001
```
